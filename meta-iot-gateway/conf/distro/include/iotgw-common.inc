## meta-iot-gateway/conf/distro/iotgw.conf
```bitbake
INIT_MANAGER ?= "systemd"

DISTRO = "iotgw"
DISTRO_NAME = "IoT Gateway OS"

# Match Poky's default package format unless intentionally changed
PACKAGE_CLASSES ?= "package_rpm"

# Uninative (host-distro-stable native toolchain) comes from OE-Core's
# defaultsetup.conf: yocto-uninative.inc + INHERIT_DISTRO's `uninative`.

# Security hardening (PIE, stack protector, FORTIFY_SOURCE, RELRO)
require conf/distro/include/iotgw-security.inc

# Centralized common settings (branding, versioning, QA, RAUC, SDK)
require conf/distro/include/iotgw-common.inc
```

## meta-iot-gateway/conf/distro/meshiot.conf
```bitbake
require conf/distro/iotgw.conf

# Branding-only variant of the iotgw distro
# Keeps target/vendor triplets and providers unchanged to avoid rebuild churn.

DISTRO = "meshiot"
DISTRO_NAME = "Mesh IoT OS"

# Optional: set a release codename for branding (inherits default otherwise)
# DISTRO_CODENAME = "scarthgap"

# Optional: if you want distinct RAUC bundle compatibility, uncomment and update
# NOTE: Changing compatibility requires matching system.conf on devices
# RAUC_BUNDLE_COMPATIBLE = "meshiot-${MACHINE}"
```

## meta-iot-gateway/conf/layer.conf
```bitbake
# We have a conf and classes directory, append to BBPATH
BBPATH .= ":${LAYERDIR}"

# We have recipes directories; include explicitly to avoid always pulling RAUC bundles
# Core/image/packagegroups stay in recipes-core
BBFILES += " \
  ${LAYERDIR}/recipes-core/images/*.bb \
  ${LAYERDIR}/recipes-core/packagegroups/*.bb \
  ${LAYERDIR}/recipes-core/base-files/*.bbappend \
  ${LAYERDIR}/recipes-compliance/*/*.bb \
  ${LAYERDIR}/recipes-network/*/*.bb \
  ${LAYERDIR}/recipes-security/*/*.bb \
  ${LAYERDIR}/recipes-connectivity/*/*.bb \
  ${LAYERDIR}/recipes-devtools/*/*.bb \
  ${LAYERDIR}/recipes-bsp/bootimage/*.bb \
  ${LAYERDIR}/recipes-bsp/bootlogo/*.bb \
  ${LAYERDIR}/recipes-bsp/bootfiles-updater/*.bb \
  ${LAYERDIR}/recipes-support/*/*.bb \
  ${LAYERDIR}/recipes-ota/rauc/*.bb \
  ${LAYERDIR}/recipes-*/*/*.bbappend \
"

# Include RAUC bundle recipes only when RAUC is enabled in DISTRO_FEATURES
BBFILES += "${@bb.utils.contains('DISTRO_FEATURES', 'rauc', ' ${LAYERDIR}/recipes-ota/bundles/*.bb', '', d)}"

BBFILE_COLLECTIONS += "iot-gateway-layer"
BBFILE_PATTERN_iot-gateway-layer = "^${LAYERDIR}/"
BBFILE_PRIORITY_iot-gateway-layer = "10"

LAYERDEPENDS_iot-gateway-layer = "core"
LAYERSERIES_COMPAT_iot-gateway-layer = "scarthgap"
```
